## kernel/linux-3.4rt/drivers/char/aei_sfp_laser/Kconfig
```kconfig
#
# Kconfig for the aei_sfp_laser driver module - aei_sfp_laser_dev.ko
#

#add a line in ../Kconfig
#source "drivers/char/aei_sfp_laser/Kconfig"

config SFP_LASER
        tristate "sfp laser card"
       ---help---
          Say Y here if you intend to attach an sckipio gfast to your computer.

          To compile this driver as a module, choose M here, If unsure, say N.
~                                                                               
```

## kernel/linux-3.4rt/drivers/net/sckipio/Kconfig
```kconfig
#
# Kconfig for the sckipio gfast driver module - gfast.ko
#

#add a line in ../Kconfig
#source "drivers/net/sckipio/Kconfig"

config SCKIPIO_GFAST
        tristate "sckipio gfast card"
       ---help---
          Say Y here if you intend to attach an sckipio gfast to your computer.

          To compile this driver as a module, choose M here, If unsure, say N.
```

## kernel/linux-3.4rt/drivers/net/wireless/quantenna/Kconfig
```kconfig
#
# Kconfig for the quantenna 11ac driver module - qdpc-host.ko
#

#add a line in ../Kconfig
#source "drivers/net/wireless/quantenna/Kconfig"

config QUANTENNA_11AC
        tristate "Quantenna PCIe 11ac WiFi card"
       ---help---
          Say Y here if you intend to attach an Quantenna PCIe
          wireless Ethernet networking card to your computer.

          To compile this driver as a module, choose M here, If unsure, say N.
```

## kernel/linux-3.4rt/net/netfilter/ip2p/Kconfig
```kconfig
#
# IP P2P configuration
#
menuconfig IP_P2P
	tristate "IP P2P support"
	depends on NET && INET && NETFILTER
	depends on (NF_CONNTRACK || NF_CONNTRACK=n)
	---help---
      Michelle is me

	  If you want to compile it in kernel, say Y. To compile it as a
	  module, choose M here. If unsure, say N.
```
